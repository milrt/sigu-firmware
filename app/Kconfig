## app/Kconfig
```kconfig
# Copyright (C) 2025 milrt <milrt@proton.me>
# SPDX-License-Identifier: GPL-3.0-or-later

config SIGU_SELFTEST
	bool "Build the self-test wallet and the TFM_BITCOIN_TEST service"
	help
	  Adds the second service to the partition, the test wallet session with
	  programmatic approval, and both test suites. It is off by default, so the
	  default image has one wallet session and no way to approve a transaction
	  without OK on the review screen. prj_dev.conf turns it on. The non-secure
	  sources see CONFIG_SIGU_SELFTEST, the partition sources see SIGU_SELFTEST.

config SIGU_RELEASE
	bool "Release image (set by sysbuild)"
	help
	  Set by sysbuild from SB_CONFIG_SIGU_RELEASE. app/CMakeLists.txt then
	  refuses the self-tests, the shell and the TF-M exception dump.

config SIGU_WATCHDOG_TIMEOUT_MS
	int "WDT31 timeout in ms"
	default 8000
	help
	  NS feeds WDT31 after each status call to the partition, so the
	  timeout must be longer than the longest partition call. A reset
	  before the confirm of a new app makes MCUboot swap the old one back.
	  prj_dev.conf raises it for the shell self-tests.

menu "Zephyr"
source "Kconfig.zephyr"
endmenu
```

## app/Kconfig.sysbuild
```kconfig
# Copyright (C) 2025 milrt <milrt@proton.me>
# SPDX-License-Identifier: GPL-3.0-or-later

source "share/sysbuild/Kconfig"

config SIGU_RELEASE
	bool "Release image"
	help
	  Set by sysbuild.conf, and turned off by sysbuild_dev.conf. sysbuild.cmake
	  refuses a missing, default, in-repo or shared signing key for b0 and
	  MCUboot. It also sets CONFIG_SIGU_RELEASE in the app, and
	  app/CMakeLists.txt then refuses the dev features of prj_dev.conf.
```

## west.yml
```yaml
manifest:
  self:
    path: sigu-firmware

  remotes:
    - name: nrf
      url-base: https://github.com/nrfconnect
    - name: bitcoin-core
      url-base: https://github.com/bitcoin-core
    - name: bitcoin
      url-base: https://github.com/bitcoin
    - name: nayuki
      url-base: https://github.com/nayuki

  projects:
    - name: sdk-nrf
      remote: nrf
      path: nrf
      revision: v3.4.0
      import:
        path-prefix: external
        name-allowlist:
          - zephyr
          - mcuboot
          - trusted-firmware-m
          - qcbor
          - t_cose
          - mbedtls
          - oberon-psa-crypto
          - tf-psa-crypto
          - nrfxlib
          - hal_nordic
          - cmsis
          - cmsis_6
          - picolibc
          - zcbor
          - fatfs
      clone-depth: 1

    - name: secp256k1
      remote: bitcoin-core
      revision: v0.8.0
      path: external/bitcoin/secp256k1

    - name: bips
      remote: bitcoin
      revision: b9f9a8d6e854fa0b0c8f818753420b0aa6e875aa
      path: external/bitcoin/bips

    - name: libbase58
      remote: bitcoin
      revision: b1dd03fa8d1be4be076bb6152325c6b5cf64f678
      path: external/bitcoin/libbase58

    - name: QR-Code-generator
      remote: nayuki
      revision: 720f62bddb7226106071d4728c292cb1df519ceb # v1.8.0
      path: external/qrcodegen
```
